ASAP2_VERSION 1 41
/begin PROJECT PC_PC "Generated by ETAS from Project PC_PC"
/begin HEADER "" VERSION "000" PROJECT_NO ASD /end HEADER
/begin MODULE PC_PC "Generated by ETAS ASCET7 from Project: PC_PC"
/begin IF_DATA E_TARGET
 /begin SOURCE "Task0" 3 /* period */ 10 QP_BLOB 1 /end SOURCE
 /begin TP_BLOB /* programm id */ 3347068501 /* target id */ 7 0 2 0 /end TP_BLOB
/end IF_DATA
/begin MOD_PAR "" VERSION "000" ADDR_EPK 0x0 EPK "" SUPPLIER "ETAS GmbH" CUSTOMER "xxx" CUSTOMER_NO "000" USER "xxx" PHONE_NO "000" ECU "PC" CPU_TYPE "PCx86" NO_OF_INTERFACES 1 /end MOD_PAR
/begin MOD_COMMON "Common definitions" BYTE_ORDER MSB_LAST ALIGNMENT_BYTE 1 ALIGNMENT_WORD 2 ALIGNMENT_LONG 4 ALIGNMENT_FLOAT32_IEEE 4 ALIGNMENT_FLOAT64_IEEE 8 /end MOD_COMMON
/begin MEASUREMENT myCar.myCar.myDrive_instance.Drivetrain_instance.Battery_inst.battery "" FLOAT32_IEEE esdl_ident 1 100.0 0.0 1000.0 ECU_ADDRESS 0x0 /end MEASUREMENT
/begin CHARACTERISTIC myCar.myCar.myDrive_instance.Drivetrain_instance.Battery_inst.weight "" VALUE 0x0 STANDARD_VALUE_R32 0.0 esdl_ident -3.4028234663852886E+38 3.4028234663852886E+38 /end CHARACTERISTIC
/begin MEASUREMENT myCar.myCar.myDrive_instance.Drivetrain_instance.BM_inst.sm "" UBYTE esdl_myCar_BatteryMomentumStatemachineStates 1 100.0 0 2 ECU_ADDRESS 0x0 /end MEASUREMENT
/begin MEASUREMENT myCar.myCar.myDrive_instance.Drivetrain_instance.BM_inst.battery "" FLOAT32_IEEE esdl_ident 1 100.0 -3.4028234663852886E+38 3.4028234663852886E+38 ECU_ADDRESS 0x0 /end MEASUREMENT
/begin MEASUREMENT myCar.myCar.myDrive_instance.Drivetrain_instance.BM_inst.momentum "" FLOAT32_IEEE esdl_ident 1 100.0 -3.4028234663852886E+38 3.4028234663852886E+38 ECU_ADDRESS 0x0 /end MEASUREMENT
/begin MEASUREMENT myCar.myCar.myDrive_instance.Drivetrain_instance.BM_inst.accelMomentum "" FLOAT32_IEEE esdl_ident 1 100.0 -3.4028234663852886E+38 3.4028234663852886E+38 ECU_ADDRESS 0x0 /end MEASUREMENT
/begin MEASUREMENT myCar.myCar.myDrive_instance.Drivetrain_instance.BM_inst.recupMomentum "" FLOAT32_IEEE esdl_ident 1 100.0 -3.4028234663852886E+38 3.4028234663852886E+38 ECU_ADDRESS 0x0 /end MEASUREMENT
/begin MEASUREMENT myCar.myCar.myDrive_instance.Drivetrain_instance.BM_inst.empty "" UBYTE esdl_ident 1 100.0 0 1 ECU_ADDRESS 0x0 BIT_MASK 0x1 /end MEASUREMENT
/begin MEASUREMENT myCar.myCar.myDrive_instance.Drivetrain_instance.BM_inst.full "" UBYTE esdl_ident 1 100.0 0 1 ECU_ADDRESS 0x0 BIT_MASK 0x1 /end MEASUREMENT
/begin MEASUREMENT myCar.myCar.myDrive_instance.Drivetrain_instance.CM_inst.sm "" UBYTE esdl_myCar_CrawlingManagerStatemachineStates 1 100.0 0 3 ECU_ADDRESS 0x0 /end MEASUREMENT
/begin MEASUREMENT myCar.myCar.myDrive_instance.Drivetrain_instance.CM_inst.batteryEmpty "" UBYTE esdl_ident 1 100.0 0 1 ECU_ADDRESS 0x0 BIT_MASK 0x1 /end MEASUREMENT
/begin MEASUREMENT myCar.myCar.myDrive_instance.Drivetrain_instance.CM_inst.odometer "" FLOAT32_IEEE esdl_ident 1 100.0 -3.4028234663852886E+38 3.4028234663852886E+38 ECU_ADDRESS 0x0 /end MEASUREMENT
/begin MEASUREMENT myCar.myCar.myDrive_instance.Drivetrain_instance.CM_inst.v "" FLOAT32_IEEE esdl_ident 1 100.0 -3.4028234663852886E+38 3.4028234663852886E+38 ECU_ADDRESS 0x0 /end MEASUREMENT
/begin MEASUREMENT myCar.myCar.myDrive_instance.Drivetrain_instance.CM_inst.power "" FLOAT32_IEEE esdl_ident 1 100.0 -3.4028234663852886E+38 3.4028234663852886E+38 ECU_ADDRESS 0x0 /end MEASUREMENT
/begin MEASUREMENT myCar.myCar.myDrive_instance.Drivetrain_instance.CM_inst.driverPower "" FLOAT32_IEEE esdl_ident 1 100.0 -3.4028234663852886E+38 3.4028234663852886E+38 ECU_ADDRESS 0x0 /end MEASUREMENT
/begin MEASUREMENT myCar.myCar.myDrive_instance.Drivetrain_instance.CM_inst.crawlingStartOdometer "" FLOAT32_IEEE esdl_ident 1 100.0 -3.4028234663852886E+38 3.4028234663852886E+38 ECU_ADDRESS 0x0 /end MEASUREMENT
/begin CHARACTERISTIC myCar.myCar.myDrive_instance.Drivetrain_instance.CM_inst.crawlingTargetSpeed "" VALUE 0x0 STANDARD_VALUE_R32 0.0 esdl_ident -3.4028234663852886E+38 3.4028234663852886E+38 /end CHARACTERISTIC
/begin CHARACTERISTIC myCar.myCar.myDrive_instance.Drivetrain_instance.CM_inst.crawlingTargetDistance "" VALUE 0x0 STANDARD_VALUE_R32 0.0 esdl_ident -3.4028234663852886E+38 3.4028234663852886E+38 /end CHARACTERISTIC
/begin CHARACTERISTIC myCar.myCar.myDrive_instance.Drivetrain_instance.CM_inst.crawlingPower "" VALUE 0x0 STANDARD_VALUE_R32 0.0 esdl_ident -3.4028234663852886E+38 3.4028234663852886E+38 /end CHARACTERISTIC
/begin CHARACTERISTIC myCar.myCar.myDrive_instance.Drivetrain_instance.RecuperationAccel "" CURVE 0x0 STANDARD_CURVE_R32R32 0.0 esdl_ident -3.4028234663852886E+38 3.4028234663852886E+38
 /begin AXIS_DESCR STD_AXIS NO_INPUT_QUANTITY esdl_ident 2 -3.4028234663852886E+38 3.4028234663852886E+38 /end AXIS_DESCR
/end CHARACTERISTIC
/begin CHARACTERISTIC myCar.myCar.myDrive_instance.Drivetrain_instance.EngineMomentum "" MAP 0x0 STANDARD_MAP_R32R32R32 0.0 esdl_ident -3.4028234663852886E+38 3.4028234663852886E+38
 /begin AXIS_DESCR STD_AXIS NO_INPUT_QUANTITY esdl_ident 6 -3.4028234663852886E+38 3.4028234663852886E+38 /end AXIS_DESCR
 /begin AXIS_DESCR STD_AXIS NO_INPUT_QUANTITY esdl_ident 6 -3.4028234663852886E+38 3.4028234663852886E+38 /end AXIS_DESCR
/end CHARACTERISTIC
/begin MEASUREMENT myCar.myCar.myDrive_instance.Drivetrain_instance.momentum "" FLOAT32_IEEE esdl_ident 1 100.0 -3.4028234663852886E+38 3.4028234663852886E+38 ECU_ADDRESS 0x0 /end MEASUREMENT
/begin MEASUREMENT myCar.myCar.myDrive_instance.Drivetrain_instance.batteryEmpty "" UBYTE esdl_ident 1 100.0 0 1 ECU_ADDRESS 0x0 BIT_MASK 0x1 /end MEASUREMENT
/begin MEASUREMENT myCar.myCar.myDrive_instance.Environment_instance.dist "" FLOAT32_IEEE esdl_ident 1 100.0 -3.4028234663852886E+38 3.4028234663852886E+38 ECU_ADDRESS 0x0 /end MEASUREMENT
/begin MEASUREMENT myCar.myCar.myDrive_instance.Environment_instance.h "" FLOAT32_IEEE esdl_ident 1 100.0 -3.4028234663852886E+38 3.4028234663852886E+38 ECU_ADDRESS 0x0 /end MEASUREMENT
/begin CHARACTERISTIC myCar.myCar.myDrive_instance.Environment_instance.Landscape "" CURVE 0x0 STANDARD_CURVE_R32R32 0.0 esdl_ident -3.4028234663852886E+38 3.4028234663852886E+38
 /begin AXIS_DESCR STD_AXIS myCar.myCar.myDrive_instance.Environment_instance.dist esdl_ident 20 -3.4028234663852886E+38 3.4028234663852886E+38 /end AXIS_DESCR
/end CHARACTERISTIC
/begin MEASUREMENT myCar.myCar.myDrive_instance.Environment_instance.ds "" FLOAT32_IEEE esdl_ident 1 100.0 -3.4028234663852886E+38 3.4028234663852886E+38 ECU_ADDRESS 0x0 /end MEASUREMENT
/begin MEASUREMENT myCar.myCar.myDrive_instance.Environment_instance.dh "" FLOAT32_IEEE esdl_ident 1 100.0 -3.4028234663852886E+38 3.4028234663852886E+38 ECU_ADDRESS 0x0 /end MEASUREMENT
/begin CHARACTERISTIC myCar.myCar.myDrive_instance.Environment_instance.TrackSize "" VALUE 0x0 STANDARD_VALUE_R32 0.0 esdl_ident -3.4028234663852886E+38 3.4028234663852886E+38 /end CHARACTERISTIC
/begin MEASUREMENT myCar.myCar.myDrive_instance.odo_inst.odometer "" FLOAT32_IEEE esdl_ident 1 100.0 -3.4028234663852886E+38 3.4028234663852886E+38 ECU_ADDRESS 0x0 /end MEASUREMENT
/begin CHARACTERISTIC myCar.myCar.myDrive_instance.BrakeMomentuC "" CURVE 0x0 STANDARD_CURVE_R32R32 0.0 esdl_ident -3.4028234663852886E+38 3.4028234663852886E+38
 /begin AXIS_DESCR STD_AXIS NO_INPUT_QUANTITY esdl_ident 6 -3.4028234663852886E+38 3.4028234663852886E+38 /end AXIS_DESCR
/end CHARACTERISTIC
/begin CHARACTERISTIC myCar.myCar.myDrive_instance.AirFriction "" CURVE 0x0 STANDARD_CURVE_R32R32 0.0 esdl_ident -3.4028234663852886E+38 3.4028234663852886E+38
 /begin AXIS_DESCR STD_AXIS myCar.myCar.myDrive_instance.v esdl_ident 6 -3.4028234663852886E+38 3.4028234663852886E+38 /end AXIS_DESCR
/end CHARACTERISTIC
/begin MEASUREMENT myCar.myCar.myDrive_instance.v "" FLOAT32_IEEE esdl_ident 1 100.0 -3.4028234663852886E+38 3.4028234663852886E+38 ECU_ADDRESS 0x0 /end MEASUREMENT
/begin MEASUREMENT myCar.myCar.myDrive_instance.kmstand "" FLOAT32_IEEE esdl_ident 1 100.0 -3.4028234663852886E+38 3.4028234663852886E+38 ECU_ADDRESS 0x0 /end MEASUREMENT
/begin CHARACTERISTIC myCar.myCar.g "" VALUE 0x0 STANDARD_VALUE_R32 0.0 esdl_ident -3.4028234663852886E+38 3.4028234663852886E+38 /end CHARACTERISTIC
/begin CHARACTERISTIC myCar.myCar.weight "" VALUE 0x0 STANDARD_VALUE_R32 0.0 esdl_ident -3.4028234663852886E+38 3.4028234663852886E+38 /end CHARACTERISTIC
/begin MEASUREMENT resources.CarMessages.v "" UWORD esdl_f0_01_kmh_km2fh 1 100.0 0.0 200.0 ECU_ADDRESS 0x0 /end MEASUREMENT
/begin MEASUREMENT resources.CarMessages.power "" FLOAT32_IEEE esdl_ident 1 100.0 -3.4028234663852886E+38 3.4028234663852886E+38 ECU_ADDRESS 0x0 /end MEASUREMENT
/begin MEASUREMENT resources.CarMessages.brake "" FLOAT32_IEEE esdl_ident 1 100.0 -3.4028234663852886E+38 3.4028234663852886E+38 ECU_ADDRESS 0x0 /end MEASUREMENT
/begin MEASUREMENT resources.CarMessages.recuperation "" FLOAT32_IEEE esdl_ident 1 100.0 -3.4028234663852886E+38 3.4028234663852886E+38 ECU_ADDRESS 0x0 /end MEASUREMENT
/begin MEASUREMENT myCar.CCF.TVI.v "" FLOAT32_IEEE esdl_ident 1 100.0 -3.4028234663852886E+38 3.4028234663852886E+38 ECU_ADDRESS 0x0 /end MEASUREMENT
/begin CHARACTERISTIC myCar.CCF.TVI.dv "" VALUE 0x0 STANDARD_VALUE_R32 0.0 esdl_ident -3.4028234663852886E+38 3.4028234663852886E+38 /end CHARACTERISTIC
/begin CHARACTERISTIC myCar.CCF.TVI.mn "" VALUE 0x0 STANDARD_VALUE_R32 0.0 esdl_ident -3.4028234663852886E+38 3.4028234663852886E+38 /end CHARACTERISTIC
/begin CHARACTERISTIC myCar.CCF.TVI.mx "" VALUE 0x0 STANDARD_VALUE_R32 0.0 esdl_ident -3.4028234663852886E+38 3.4028234663852886E+38 /end CHARACTERISTIC
/begin MEASUREMENT myCar.CCF.OnRising.buffer "" UBYTE esdl_ident 1 100.0 0 1 ECU_ADDRESS 0x0 BIT_MASK 0x1 /end MEASUREMENT
/begin MEASUREMENT myCar.CCF.OnRising.oldSignal "" UBYTE esdl_ident 1 100.0 0 1 ECU_ADDRESS 0x0 BIT_MASK 0x1 /end MEASUREMENT
/begin MEASUREMENT myCar.CCF.PID_instance.inOLD "" FLOAT64_IEEE esdl_ident 1 100.0 -1.7976931348623157E+308 1.7976931348623157E+308 ECU_ADDRESS 0x0 /end MEASUREMENT
/begin MEASUREMENT myCar.CCF.PID_instance.memory1 "" FLOAT64_IEEE esdl_ident 1 100.0 -1.7976931348623157E+308 1.7976931348623157E+308 ECU_ADDRESS 0x0 /end MEASUREMENT
/begin MEASUREMENT myCar.CCF.PID_instance.memory2 "" FLOAT64_IEEE esdl_ident 1 100.0 -1.7976931348623157E+308 1.7976931348623157E+308 ECU_ADDRESS 0x0 /end MEASUREMENT
/begin MEASUREMENT myCar.CCF.IncRising.buffer "" UBYTE esdl_ident 1 100.0 0 1 ECU_ADDRESS 0x0 BIT_MASK 0x1 /end MEASUREMENT
/begin MEASUREMENT myCar.CCF.IncRising.oldSignal "" UBYTE esdl_ident 1 100.0 0 1 ECU_ADDRESS 0x0 BIT_MASK 0x1 /end MEASUREMENT
/begin MEASUREMENT myCar.CCF.DecRising.buffer "" UBYTE esdl_ident 1 100.0 0 1 ECU_ADDRESS 0x0 BIT_MASK 0x1 /end MEASUREMENT
/begin MEASUREMENT myCar.CCF.DecRising.oldSignal "" UBYTE esdl_ident 1 100.0 0 1 ECU_ADDRESS 0x0 BIT_MASK 0x1 /end MEASUREMENT
/begin MEASUREMENT myCar.CCF.SplitSignal_instance.plus "" FLOAT32_IEEE esdl_ident 1 100.0 -3.4028234663852886E+38 3.4028234663852886E+38 ECU_ADDRESS 0x0 /end MEASUREMENT
/begin MEASUREMENT myCar.CCF.SplitSignal_instance.minus "" FLOAT32_IEEE esdl_ident 1 100.0 -3.4028234663852886E+38 3.4028234663852886E+38 ECU_ADDRESS 0x0 /end MEASUREMENT
/begin MEASUREMENT myCar.CCF.CCFS.sm "" UBYTE esdl_myCar_CCFStateStatemachineStates 1 100.0 0 1 ECU_ADDRESS 0x0 /end MEASUREMENT
/begin MEASUREMENT myCar.CCF.CCFS.pow "" FLOAT32_IEEE esdl_ident 1 100.0 -3.4028234663852886E+38 3.4028234663852886E+38 ECU_ADDRESS 0x0 /end MEASUREMENT
/begin MEASUREMENT myCar.CCF.CCFS.bra "" FLOAT32_IEEE esdl_ident 1 100.0 -3.4028234663852886E+38 3.4028234663852886E+38 ECU_ADDRESS 0x0 /end MEASUREMENT
/begin MEASUREMENT myCar.CCF.CCFS.pw "" FLOAT32_IEEE esdl_ident 1 100.0 -3.4028234663852886E+38 3.4028234663852886E+38 ECU_ADDRESS 0x0 /end MEASUREMENT
/begin MEASUREMENT myCar.CCF.CCFS.br "" FLOAT32_IEEE esdl_ident 1 100.0 -3.4028234663852886E+38 3.4028234663852886E+38 ECU_ADDRESS 0x0 /end MEASUREMENT
/begin MEASUREMENT myCar.CCF.CCFS.on "" UBYTE esdl_ident 1 100.0 0 1 ECU_ADDRESS 0x0 BIT_MASK 0x1 /end MEASUREMENT
/begin MEASUREMENT myCar.CCF.CCFS.act "" UBYTE esdl_ident 1 100.0 0 1 ECU_ADDRESS 0x0 BIT_MASK 0x1 /end MEASUREMENT
/begin MEASUREMENT myCar.CCF.CCFS.ctrl "" FLOAT32_IEEE esdl_ident 1 100.0 -3.4028234663852886E+38 3.4028234663852886E+38 ECU_ADDRESS 0x0 /end MEASUREMENT
/begin MEASUREMENT myCar.CCF.PI_instance.memory1 "" FLOAT64_IEEE esdl_ident 1 100.0 -1.7976931348623157E+308 1.7976931348623157E+308 ECU_ADDRESS 0x0 /end MEASUREMENT
/begin MEASUREMENT myCar.CCF.PI_instance.memory2 "" FLOAT64_IEEE esdl_ident 1 100.0 -1.7976931348623157E+308 1.7976931348623157E+308 ECU_ADDRESS 0x0 /end MEASUREMENT
/begin MEASUREMENT myCar.CCF.PID_instance_2.inOLD "" FLOAT64_IEEE esdl_ident 1 100.0 -1.7976931348623157E+308 1.7976931348623157E+308 ECU_ADDRESS 0x0 /end MEASUREMENT
/begin MEASUREMENT myCar.CCF.PID_instance_2.memory1 "" FLOAT64_IEEE esdl_ident 1 100.0 -1.7976931348623157E+308 1.7976931348623157E+308 ECU_ADDRESS 0x0 /end MEASUREMENT
/begin MEASUREMENT myCar.CCF.PID_instance_2.memory2 "" FLOAT64_IEEE esdl_ident 1 100.0 -1.7976931348623157E+308 1.7976931348623157E+308 ECU_ADDRESS 0x0 /end MEASUREMENT
/begin MEASUREMENT myCar.CCF.vsoll "" FLOAT32_IEEE esdl_ident 1 100.0 -3.4028234663852886E+38 3.4028234663852886E+38 ECU_ADDRESS 0x0 /end MEASUREMENT
/begin CHARACTERISTIC myCar.CCF.K "" VALUE 0x0 STANDARD_VALUE_R32 0.0 esdl_ident -3.4028234663852886E+38 3.4028234663852886E+38 /end CHARACTERISTIC
/begin CHARACTERISTIC myCar.CCF.TV "" VALUE 0x0 STANDARD_VALUE_R32 0.0 esdl_ident -3.4028234663852886E+38 3.4028234663852886E+38 /end CHARACTERISTIC
/begin CHARACTERISTIC myCar.CCF.TN "" VALUE 0x0 STANDARD_VALUE_R32 0.0 esdl_ident -3.4028234663852886E+38 3.4028234663852886E+38 /end CHARACTERISTIC
/begin CHARACTERISTIC myCar.CCF.mn "" VALUE 0x0 STANDARD_VALUE_R32 0.0 esdl_ident -3.4028234663852886E+38 3.4028234663852886E+38 /end CHARACTERISTIC
/begin CHARACTERISTIC myCar.CCF.mx "" VALUE 0x0 STANDARD_VALUE_R32 0.0 esdl_ident -3.4028234663852886E+38 3.4028234663852886E+38 /end CHARACTERISTIC
/begin CHARACTERISTIC myCar.CCF.vs "" VALUE 0x0 STANDARD_VALUE_R32 0.0 esdl_ident -3.4028234663852886E+38 3.4028234663852886E+38 /end CHARACTERISTIC
/begin MEASUREMENT myCar.CCF.ctl "" FLOAT32_IEEE esdl_ident 1 100.0 -3.4028234663852886E+38 3.4028234663852886E+38 ECU_ADDRESS 0x0 /end MEASUREMENT
/begin CHARACTERISTIC myCar.CCF.brake "" VALUE 0x0 STANDARD_VALUE_R32 0.0 esdl_ident -3.4028234663852886E+38 3.4028234663852886E+38 /end CHARACTERISTIC
/begin CHARACTERISTIC myCar.CCF.power "" VALUE 0x0 STANDARD_VALUE_R32 0.0 esdl_ident -3.4028234663852886E+38 3.4028234663852886E+38 /end CHARACTERISTIC
/begin CHARACTERISTIC myCar.CCF.withRecup "" VALUE 0x0 STANDARD_VALUE_U8 0.0 esdl_ident 0 1 BIT_MASK 0x1 /end CHARACTERISTIC
/begin MEASUREMENT myCar.CCF.br "" FLOAT32_IEEE esdl_ident 1 100.0 -3.4028234663852886E+38 3.4028234663852886E+38 ECU_ADDRESS 0x0 /end MEASUREMENT
/begin MEASUREMENT myCar.CCF.v "" FLOAT32_IEEE esdl_ident 1 100.0 -3.4028234663852886E+38 3.4028234663852886E+38 ECU_ADDRESS 0x0 /end MEASUREMENT
/begin CHARACTERISTIC myCar.CCF.PIDactive "" VALUE 0x0 STANDARD_VALUE_U8 0.0 esdl_ident 0 1 BIT_MASK 0x1 /end CHARACTERISTIC
/begin MEASUREMENT resources.DriverMessages.brake "" FLOAT32_IEEE esdl_ident 1 100.0 -3.4028234663852886E+38 3.4028234663852886E+38 ECU_ADDRESS 0x0 /end MEASUREMENT
/begin MEASUREMENT resources.DriverMessages.power "" FLOAT32_IEEE esdl_ident 1 100.0 -3.4028234663852886E+38 3.4028234663852886E+38 ECU_ADDRESS 0x0 /end MEASUREMENT
/begin MEASUREMENT resources.DriverMessages.recuperation "" FLOAT32_IEEE esdl_ident 1 100.0 -3.4028234663852886E+38 3.4028234663852886E+38 ECU_ADDRESS 0x0 /end MEASUREMENT
/begin MEASUREMENT resources.DriverMessages.on "" UBYTE esdl_ident 1 100.0 0 1 ECU_ADDRESS 0x0 BIT_MASK 0x1 /end MEASUREMENT
/begin MEASUREMENT resources.DriverMessages.display "" UBYTE esdl_ident 1 100.0 0 1 ECU_ADDRESS 0x0 BIT_MASK 0x1 /end MEASUREMENT
/begin MEASUREMENT resources.DriverMessages.increment "" UBYTE esdl_ident 1 100.0 0 1 ECU_ADDRESS 0x0 BIT_MASK 0x1 /end MEASUREMENT
/begin MEASUREMENT resources.DriverMessages.decrement "" UBYTE esdl_ident 1 100.0 0 1 ECU_ADDRESS 0x0 BIT_MASK 0x1 /end MEASUREMENT
/begin CHARACTERISTIC myCar.Driver.power "" VALUE 0x0 STANDARD_VALUE_R32 0.0 esdl_ident -3.4028234663852886E+38 3.4028234663852886E+38 /end CHARACTERISTIC
/begin CHARACTERISTIC myCar.Driver.brake "" VALUE 0x0 STANDARD_VALUE_R32 0.0 esdl_ident -3.4028234663852886E+38 3.4028234663852886E+38 /end CHARACTERISTIC
/begin CHARACTERISTIC myCar.Driver.on "" VALUE 0x0 STANDARD_VALUE_U8 0.0 esdl_ident 0 1 BIT_MASK 0x1 /end CHARACTERISTIC
/begin CHARACTERISTIC myCar.Driver.inc "" VALUE 0x0 STANDARD_VALUE_U8 0.0 esdl_ident 0 1 BIT_MASK 0x1 /end CHARACTERISTIC
/begin CHARACTERISTIC myCar.Driver.dec "" VALUE 0x0 STANDARD_VALUE_U8 0.0 esdl_ident 0 1 BIT_MASK 0x1 /end CHARACTERISTIC
/begin CHARACTERISTIC myCar.Driver.recuperation "" VALUE 0x0 STANDARD_VALUE_R32 0.0 esdl_ident -3.4028234663852886E+38 3.4028234663852886E+38 /end CHARACTERISTIC
/begin MEASUREMENT SystemLib.Miscellaneous.DeltaTimeService.deltaT "This value contains the delta time between two subsequent task activations in seconds. There are several representations possible." FLOAT32_IEEE esdl_ident 1 100.0 0.0 100.0 ECU_ADDRESS 0x0 /end MEASUREMENT
/begin COMPU_METHOD esdl_f0_01_kmh_km2fh "" RAT_FUNC "%12.4" "km/h" /* coeffs */ COEFFS 0 100 0 0 0 1 /end COMPU_METHOD
/begin COMPU_METHOD esdl_ident "" RAT_FUNC "%12.4" "" /* coeffs */ COEFFS 0 1 0 0 0 1 /end COMPU_METHOD
/begin COMPU_METHOD esdl_myCar_BatteryMomentumStatemachineStates "" TAB_VERB "%12.4" "" COMPU_TAB_REF esdl_myCar_BatteryMomentumStatemachineStates_vtab /end COMPU_METHOD
/begin COMPU_VTAB esdl_myCar_BatteryMomentumStatemachineStates_vtab "" TAB_VERB 3 0 "Full" 1 "Empty" 2 "Operational" DEFAULT_VALUE "Error" /end COMPU_VTAB
/begin COMPU_METHOD esdl_myCar_CCFStateStatemachineStates "" TAB_VERB "%12.4" "" COMPU_TAB_REF esdl_myCar_CCFStateStatemachineStates_vtab /end COMPU_METHOD
/begin COMPU_VTAB esdl_myCar_CCFStateStatemachineStates_vtab "" TAB_VERB 2 0 "PassThrough" 1 "Control" DEFAULT_VALUE "Error" /end COMPU_VTAB
/begin COMPU_METHOD esdl_myCar_CrawlingManagerStatemachineStates "" TAB_VERB "%12.4" "" COMPU_TAB_REF esdl_myCar_CrawlingManagerStatemachineStates_vtab /end COMPU_METHOD
/begin COMPU_VTAB esdl_myCar_CrawlingManagerStatemachineStates_vtab "" TAB_VERB 4 0 "NormalOperation" 3 "Waiting" 1 "Crawling" 2 "ReallyEmpty" DEFAULT_VALUE "Error" /end COMPU_VTAB
/begin FUNCTION myCar.myCar "" /begin DEF_CHARACTERISTIC myCar.myCar.g myCar.myCar.weight /end DEF_CHARACTERISTIC
 /begin IN_MEASUREMENT resources.CarMessages.brake resources.CarMessages.power resources.CarMessages.recuperation /end IN_MEASUREMENT
 /begin OUT_MEASUREMENT resources.CarMessages.v /end OUT_MEASUREMENT
 /begin SUB_FUNCTION myCar.myCar.myDrive_instance /end SUB_FUNCTION
/end FUNCTION
/begin FUNCTION myCar.myCar.myDrive_instance ""
 /begin DEF_CHARACTERISTIC myCar.myCar.myDrive_instance.BrakeMomentuC myCar.myCar.myDrive_instance.AirFriction /end DEF_CHARACTERISTIC
 /begin LOC_MEASUREMENT myCar.myCar.myDrive_instance.kmstand myCar.myCar.myDrive_instance.v /end LOC_MEASUREMENT
 /begin SUB_FUNCTION myCar.myCar.myDrive_instance.Drivetrain_instance myCar.myCar.myDrive_instance.Environment_instance myCar.myCar.myDrive_instance.odo_inst /end SUB_FUNCTION
/end FUNCTION
/begin FUNCTION myCar.myCar.myDrive_instance.Drivetrain_instance ""
 /begin DEF_CHARACTERISTIC myCar.myCar.myDrive_instance.Drivetrain_instance.RecuperationAccel myCar.myCar.myDrive_instance.Drivetrain_instance.EngineMomentum /end DEF_CHARACTERISTIC
 /begin LOC_MEASUREMENT myCar.myCar.myDrive_instance.Drivetrain_instance.batteryEmpty myCar.myCar.myDrive_instance.Drivetrain_instance.momentum /end LOC_MEASUREMENT
 /begin SUB_FUNCTION myCar.myCar.myDrive_instance.Drivetrain_instance.BM_inst myCar.myCar.myDrive_instance.Drivetrain_instance.Battery_inst myCar.myCar.myDrive_instance.Drivetrain_instance.CM_inst /end SUB_FUNCTION
/end FUNCTION
/begin FUNCTION myCar.myCar.myDrive_instance.Drivetrain_instance.Battery_inst ""
 /begin DEF_CHARACTERISTIC myCar.myCar.myDrive_instance.Drivetrain_instance.Battery_inst.weight /end DEF_CHARACTERISTIC
 /begin LOC_MEASUREMENT myCar.myCar.myDrive_instance.Drivetrain_instance.Battery_inst.battery /end LOC_MEASUREMENT
/end FUNCTION
/begin FUNCTION myCar.myCar.myDrive_instance.Drivetrain_instance.BM_inst ""
 /begin LOC_MEASUREMENT myCar.myCar.myDrive_instance.Drivetrain_instance.BM_inst.accelMomentum myCar.myCar.myDrive_instance.Drivetrain_instance.BM_inst.battery myCar.myCar.myDrive_instance.Drivetrain_instance.BM_inst.empty myCar.myCar.myDrive_instance.Drivetrain_instance.BM_inst.full myCar.myCar.myDrive_instance.Drivetrain_instance.BM_inst.momentum myCar.myCar.myDrive_instance.Drivetrain_instance.BM_inst.recupMomentum myCar.myCar.myDrive_instance.Drivetrain_instance.BM_inst.sm /end LOC_MEASUREMENT
/end FUNCTION
/begin FUNCTION myCar.myCar.myDrive_instance.Drivetrain_instance.CM_inst ""
 /begin DEF_CHARACTERISTIC myCar.myCar.myDrive_instance.Drivetrain_instance.CM_inst.crawlingTargetSpeed myCar.myCar.myDrive_instance.Drivetrain_instance.CM_inst.crawlingTargetDistance myCar.myCar.myDrive_instance.Drivetrain_instance.CM_inst.crawlingPower /end DEF_CHARACTERISTIC
 /begin LOC_MEASUREMENT myCar.myCar.myDrive_instance.Drivetrain_instance.CM_inst.batteryEmpty myCar.myCar.myDrive_instance.Drivetrain_instance.CM_inst.crawlingStartOdometer myCar.myCar.myDrive_instance.Drivetrain_instance.CM_inst.driverPower myCar.myCar.myDrive_instance.Drivetrain_instance.CM_inst.odometer myCar.myCar.myDrive_instance.Drivetrain_instance.CM_inst.power myCar.myCar.myDrive_instance.Drivetrain_instance.CM_inst.sm myCar.myCar.myDrive_instance.Drivetrain_instance.CM_inst.v /end LOC_MEASUREMENT
/end FUNCTION
/begin FUNCTION myCar.myCar.myDrive_instance.Environment_instance ""
 /begin DEF_CHARACTERISTIC myCar.myCar.myDrive_instance.Environment_instance.Landscape myCar.myCar.myDrive_instance.Environment_instance.TrackSize /end DEF_CHARACTERISTIC
 /begin LOC_MEASUREMENT myCar.myCar.myDrive_instance.Environment_instance.dh myCar.myCar.myDrive_instance.Environment_instance.dist myCar.myCar.myDrive_instance.Environment_instance.ds myCar.myCar.myDrive_instance.Environment_instance.h /end LOC_MEASUREMENT
/end FUNCTION
/begin FUNCTION myCar.myCar.myDrive_instance.odo_inst "" /begin LOC_MEASUREMENT myCar.myCar.myDrive_instance.odo_inst.odometer /end LOC_MEASUREMENT /end FUNCTION
/begin FUNCTION myCar.CCF ""
 /begin DEF_CHARACTERISTIC myCar.CCF.K myCar.CCF.TV myCar.CCF.TN myCar.CCF.mn myCar.CCF.mx myCar.CCF.vs myCar.CCF.brake myCar.CCF.power myCar.CCF.withRecup myCar.CCF.PIDactive /end DEF_CHARACTERISTIC
 /begin IN_MEASUREMENT resources.CarMessages.v resources.DriverMessages.brake resources.DriverMessages.decrement resources.DriverMessages.increment resources.DriverMessages.on resources.DriverMessages.power /end IN_MEASUREMENT
 /begin OUT_MEASUREMENT resources.CarMessages.brake resources.CarMessages.power resources.CarMessages.recuperation resources.DriverMessages.display /end OUT_MEASUREMENT
 /begin LOC_MEASUREMENT myCar.CCF.br myCar.CCF.ctl myCar.CCF.v myCar.CCF.vsoll /end LOC_MEASUREMENT
 /begin SUB_FUNCTION myCar.CCF.CCFS myCar.CCF.DecRising myCar.CCF.GZ myCar.CCF.IncRising myCar.CCF.Limiter_instance myCar.CCF.OnRising myCar.CCF.PID_instance myCar.CCF.PID_instance_2 myCar.CCF.PI_instance myCar.CCF.SplitSignal_instance myCar.CCF.TVI /end SUB_FUNCTION
/end FUNCTION
/begin FUNCTION myCar.CCF.TVI "" /begin DEF_CHARACTERISTIC myCar.CCF.TVI.dv myCar.CCF.TVI.mn myCar.CCF.TVI.mx /end DEF_CHARACTERISTIC /begin LOC_MEASUREMENT myCar.CCF.TVI.v /end LOC_MEASUREMENT /end FUNCTION
/begin FUNCTION myCar.CCF.OnRising "EdgeRising detects a rising edge of the logical input signal." /begin LOC_MEASUREMENT myCar.CCF.OnRising.buffer myCar.CCF.OnRising.oldSignal /end LOC_MEASUREMENT /end FUNCTION
/begin FUNCTION myCar.CCF.PID_instance "PID is a time discrete proportional integrator with differential part with time constants TV and TN and gain constant K."
 /begin LOC_MEASUREMENT myCar.CCF.PID_instance.inOLD myCar.CCF.PID_instance.memory1 myCar.CCF.PID_instance.memory2 /end LOC_MEASUREMENT
/end FUNCTION
/begin FUNCTION myCar.CCF.IncRising "EdgeRising detects a rising edge of the logical input signal." /begin LOC_MEASUREMENT myCar.CCF.IncRising.buffer myCar.CCF.IncRising.oldSignal /end LOC_MEASUREMENT /end FUNCTION
/begin FUNCTION myCar.CCF.DecRising "EdgeRising detects a rising edge of the logical input signal." /begin LOC_MEASUREMENT myCar.CCF.DecRising.buffer myCar.CCF.DecRising.oldSignal /end LOC_MEASUREMENT /end FUNCTION
/begin FUNCTION myCar.CCF.GZ "GreaterZero returns TRUE if the value val is greater than zero." /end FUNCTION
/begin FUNCTION myCar.CCF.SplitSignal_instance ""
 /begin LOC_MEASUREMENT myCar.CCF.SplitSignal_instance.minus myCar.CCF.SplitSignal_instance.plus /end LOC_MEASUREMENT
 /begin SUB_FUNCTION myCar.CCF.SplitSignal_instance.GZ /end SUB_FUNCTION
/end FUNCTION
/begin FUNCTION myCar.CCF.SplitSignal_instance.GZ "GreaterZero returns TRUE if the value val is greater than zero." /end FUNCTION
/begin FUNCTION myCar.CCF.CCFS ""
 /begin LOC_MEASUREMENT myCar.CCF.CCFS.act myCar.CCF.CCFS.br myCar.CCF.CCFS.bra myCar.CCF.CCFS.ctrl myCar.CCF.CCFS.on myCar.CCF.CCFS.pow myCar.CCF.CCFS.pw myCar.CCF.CCFS.sm /end LOC_MEASUREMENT
/end FUNCTION
/begin FUNCTION myCar.CCF.Limiter_instance "Limiter returns the input x limited by mn and mx." /end FUNCTION
/begin FUNCTION myCar.CCF.PI_instance "PI is a time discrete proportional integrator with time constant T and gain constant K."
 /begin LOC_MEASUREMENT myCar.CCF.PI_instance.memory1 myCar.CCF.PI_instance.memory2 /end LOC_MEASUREMENT
/end FUNCTION
/begin FUNCTION myCar.CCF.PID_instance_2 "PID is a time discrete proportional integrator with differential part with time constants TV and TN and gain constant K."
 /begin LOC_MEASUREMENT myCar.CCF.PID_instance_2.inOLD myCar.CCF.PID_instance_2.memory1 myCar.CCF.PID_instance_2.memory2 /end LOC_MEASUREMENT
/end FUNCTION
/begin FUNCTION myCar.Driver ""
 /begin DEF_CHARACTERISTIC myCar.Driver.power myCar.Driver.brake myCar.Driver.on myCar.Driver.inc myCar.Driver.dec myCar.Driver.recuperation /end DEF_CHARACTERISTIC
 /begin OUT_MEASUREMENT resources.CarMessages.recuperation resources.DriverMessages.brake resources.DriverMessages.decrement resources.DriverMessages.increment resources.DriverMessages.on resources.DriverMessages.power resources.DriverMessages.recuperation /end OUT_MEASUREMENT
/end FUNCTION
/begin FUNCTION SystemLib.Miscellaneous.DeltaTimeService "Provides the delta time variable" /begin OUT_MEASUREMENT SystemLib.Miscellaneous.DeltaTimeService.deltaT /end OUT_MEASUREMENT /end FUNCTION
/begin RECORD_LAYOUT STANDARD_CURVE_R32R32 /* axis size */ NO_AXIS_PTS_X 1 UWORD /* axis */ AXIS_PTS_X 2 FLOAT32_IEEE INDEX_INCR DIRECT FNC_VALUES 3 FLOAT32_IEEE COLUMN_DIR DIRECT /end RECORD_LAYOUT
/begin RECORD_LAYOUT STANDARD_MAP_R32R32R32 /* x axis size */ NO_AXIS_PTS_X 1 UWORD /* y axis size */ NO_AXIS_PTS_Y 2 UWORD /* x axis */ AXIS_PTS_X 3 FLOAT32_IEEE INDEX_INCR DIRECT /* y axis */ AXIS_PTS_Y 4 FLOAT32_IEEE INDEX_INCR DIRECT FNC_VALUES 5 FLOAT32_IEEE COLUMN_DIR DIRECT /end RECORD_LAYOUT
/begin RECORD_LAYOUT STANDARD_VALUE_R32 FNC_VALUES 1 FLOAT32_IEEE COLUMN_DIR DIRECT /end RECORD_LAYOUT
/begin RECORD_LAYOUT STANDARD_VALUE_U8 FNC_VALUES 1 UBYTE COLUMN_DIR DIRECT /end RECORD_LAYOUT
/begin GROUP SystemLib.Miscellaneous.DeltaTimeService "Provides the delta time variable" ROOT /begin REF_MEASUREMENT SystemLib.Miscellaneous.DeltaTimeService.deltaT /end REF_MEASUREMENT /end GROUP
/begin GROUP myCar.CCF "" ROOT
 /begin REF_CHARACTERISTIC myCar.CCF.K myCar.CCF.TV myCar.CCF.TN myCar.CCF.mn myCar.CCF.mx myCar.CCF.vs myCar.CCF.brake myCar.CCF.power myCar.CCF.withRecup myCar.CCF.PIDactive /end REF_CHARACTERISTIC
 /begin REF_MEASUREMENT myCar.CCF.br myCar.CCF.ctl myCar.CCF.v myCar.CCF.vsoll /end REF_MEASUREMENT
 /begin SUB_GROUP myCar.CCF.CCFS myCar.CCF.DecRising myCar.CCF.GZ myCar.CCF.IncRising myCar.CCF.Limiter_instance myCar.CCF.OnRising myCar.CCF.PID_instance myCar.CCF.PID_instance_2 myCar.CCF.PI_instance myCar.CCF.SplitSignal_instance myCar.CCF.TVI /end SUB_GROUP
/end GROUP
/begin GROUP myCar.CCF.CCFS ""
 /begin REF_MEASUREMENT myCar.CCF.CCFS.act myCar.CCF.CCFS.br myCar.CCF.CCFS.bra myCar.CCF.CCFS.ctrl myCar.CCF.CCFS.on myCar.CCF.CCFS.pow myCar.CCF.CCFS.pw myCar.CCF.CCFS.sm /end REF_MEASUREMENT
/end GROUP
/begin GROUP myCar.CCF.DecRising "EdgeRising detects a rising edge of the logical input signal." /begin REF_MEASUREMENT myCar.CCF.DecRising.buffer myCar.CCF.DecRising.oldSignal /end REF_MEASUREMENT /end GROUP
/begin GROUP myCar.CCF.GZ "GreaterZero returns TRUE if the value val is greater than zero." /end GROUP
/begin GROUP myCar.CCF.IncRising "EdgeRising detects a rising edge of the logical input signal." /begin REF_MEASUREMENT myCar.CCF.IncRising.buffer myCar.CCF.IncRising.oldSignal /end REF_MEASUREMENT /end GROUP
/begin GROUP myCar.CCF.Limiter_instance "Limiter returns the input x limited by mn and mx." /end GROUP
/begin GROUP myCar.CCF.OnRising "EdgeRising detects a rising edge of the logical input signal." /begin REF_MEASUREMENT myCar.CCF.OnRising.buffer myCar.CCF.OnRising.oldSignal /end REF_MEASUREMENT /end GROUP
/begin GROUP myCar.CCF.PID_instance "PID is a time discrete proportional integrator with differential part with time constants TV and TN and gain constant K."
 /begin REF_MEASUREMENT myCar.CCF.PID_instance.inOLD myCar.CCF.PID_instance.memory1 myCar.CCF.PID_instance.memory2 /end REF_MEASUREMENT
/end GROUP
/begin GROUP myCar.CCF.PID_instance_2 "PID is a time discrete proportional integrator with differential part with time constants TV and TN and gain constant K."
 /begin REF_MEASUREMENT myCar.CCF.PID_instance_2.inOLD myCar.CCF.PID_instance_2.memory1 myCar.CCF.PID_instance_2.memory2 /end REF_MEASUREMENT
/end GROUP
/begin GROUP myCar.CCF.PI_instance "PI is a time discrete proportional integrator with time constant T and gain constant K."
 /begin REF_MEASUREMENT myCar.CCF.PI_instance.memory1 myCar.CCF.PI_instance.memory2 /end REF_MEASUREMENT
/end GROUP
/begin GROUP myCar.CCF.SplitSignal_instance ""
 /begin REF_MEASUREMENT myCar.CCF.SplitSignal_instance.minus myCar.CCF.SplitSignal_instance.plus /end REF_MEASUREMENT
 /begin SUB_GROUP myCar.CCF.SplitSignal_instance.GZ /end SUB_GROUP
/end GROUP
/begin GROUP myCar.CCF.SplitSignal_instance.GZ "GreaterZero returns TRUE if the value val is greater than zero." /end GROUP
/begin GROUP myCar.CCF.TVI "" /begin REF_CHARACTERISTIC myCar.CCF.TVI.dv myCar.CCF.TVI.mn myCar.CCF.TVI.mx /end REF_CHARACTERISTIC /begin REF_MEASUREMENT myCar.CCF.TVI.v /end REF_MEASUREMENT /end GROUP
/begin GROUP myCar.Driver "" ROOT
 /begin REF_CHARACTERISTIC myCar.Driver.power myCar.Driver.brake myCar.Driver.on myCar.Driver.inc myCar.Driver.dec myCar.Driver.recuperation /end REF_CHARACTERISTIC
/end GROUP
/begin GROUP myCar.myCar "" ROOT /begin REF_CHARACTERISTIC myCar.myCar.g myCar.myCar.weight /end REF_CHARACTERISTIC /begin SUB_GROUP myCar.myCar.myDrive_instance /end SUB_GROUP /end GROUP
/begin GROUP myCar.myCar.myDrive_instance ""
 /begin REF_CHARACTERISTIC myCar.myCar.myDrive_instance.BrakeMomentuC myCar.myCar.myDrive_instance.AirFriction /end REF_CHARACTERISTIC
 /begin REF_MEASUREMENT myCar.myCar.myDrive_instance.kmstand myCar.myCar.myDrive_instance.v /end REF_MEASUREMENT
 /begin SUB_GROUP myCar.myCar.myDrive_instance.Drivetrain_instance myCar.myCar.myDrive_instance.Environment_instance myCar.myCar.myDrive_instance.odo_inst /end SUB_GROUP
/end GROUP
/begin GROUP myCar.myCar.myDrive_instance.Drivetrain_instance ""
 /begin REF_CHARACTERISTIC myCar.myCar.myDrive_instance.Drivetrain_instance.RecuperationAccel myCar.myCar.myDrive_instance.Drivetrain_instance.EngineMomentum /end REF_CHARACTERISTIC
 /begin REF_MEASUREMENT myCar.myCar.myDrive_instance.Drivetrain_instance.batteryEmpty myCar.myCar.myDrive_instance.Drivetrain_instance.momentum /end REF_MEASUREMENT
 /begin SUB_GROUP myCar.myCar.myDrive_instance.Drivetrain_instance.BM_inst myCar.myCar.myDrive_instance.Drivetrain_instance.Battery_inst myCar.myCar.myDrive_instance.Drivetrain_instance.CM_inst /end SUB_GROUP
/end GROUP
/begin GROUP myCar.myCar.myDrive_instance.Drivetrain_instance.BM_inst ""
 /begin REF_MEASUREMENT myCar.myCar.myDrive_instance.Drivetrain_instance.BM_inst.accelMomentum myCar.myCar.myDrive_instance.Drivetrain_instance.BM_inst.battery myCar.myCar.myDrive_instance.Drivetrain_instance.BM_inst.empty myCar.myCar.myDrive_instance.Drivetrain_instance.BM_inst.full myCar.myCar.myDrive_instance.Drivetrain_instance.BM_inst.momentum myCar.myCar.myDrive_instance.Drivetrain_instance.BM_inst.recupMomentum myCar.myCar.myDrive_instance.Drivetrain_instance.BM_inst.sm /end REF_MEASUREMENT
/end GROUP
/begin GROUP myCar.myCar.myDrive_instance.Drivetrain_instance.Battery_inst ""
 /begin REF_CHARACTERISTIC myCar.myCar.myDrive_instance.Drivetrain_instance.Battery_inst.weight /end REF_CHARACTERISTIC
 /begin REF_MEASUREMENT myCar.myCar.myDrive_instance.Drivetrain_instance.Battery_inst.battery /end REF_MEASUREMENT
/end GROUP
/begin GROUP myCar.myCar.myDrive_instance.Drivetrain_instance.CM_inst ""
 /begin REF_CHARACTERISTIC myCar.myCar.myDrive_instance.Drivetrain_instance.CM_inst.crawlingTargetSpeed myCar.myCar.myDrive_instance.Drivetrain_instance.CM_inst.crawlingTargetDistance myCar.myCar.myDrive_instance.Drivetrain_instance.CM_inst.crawlingPower /end REF_CHARACTERISTIC
 /begin REF_MEASUREMENT myCar.myCar.myDrive_instance.Drivetrain_instance.CM_inst.batteryEmpty myCar.myCar.myDrive_instance.Drivetrain_instance.CM_inst.crawlingStartOdometer myCar.myCar.myDrive_instance.Drivetrain_instance.CM_inst.driverPower myCar.myCar.myDrive_instance.Drivetrain_instance.CM_inst.odometer myCar.myCar.myDrive_instance.Drivetrain_instance.CM_inst.power myCar.myCar.myDrive_instance.Drivetrain_instance.CM_inst.sm myCar.myCar.myDrive_instance.Drivetrain_instance.CM_inst.v /end REF_MEASUREMENT
/end GROUP
/begin GROUP myCar.myCar.myDrive_instance.Environment_instance ""
 /begin REF_CHARACTERISTIC myCar.myCar.myDrive_instance.Environment_instance.Landscape myCar.myCar.myDrive_instance.Environment_instance.TrackSize /end REF_CHARACTERISTIC
 /begin REF_MEASUREMENT myCar.myCar.myDrive_instance.Environment_instance.dh myCar.myCar.myDrive_instance.Environment_instance.dist myCar.myCar.myDrive_instance.Environment_instance.ds myCar.myCar.myDrive_instance.Environment_instance.h /end REF_MEASUREMENT
/end GROUP
/begin GROUP myCar.myCar.myDrive_instance.odo_inst "" /begin REF_MEASUREMENT myCar.myCar.myDrive_instance.odo_inst.odometer /end REF_MEASUREMENT /end GROUP
/begin GROUP resources.CarMessages "" ROOT
 /begin REF_MEASUREMENT resources.CarMessages.brake resources.CarMessages.power resources.CarMessages.recuperation resources.CarMessages.v /end REF_MEASUREMENT
/end GROUP
/begin GROUP resources.DriverMessages "" ROOT
 /begin REF_MEASUREMENT resources.DriverMessages.brake resources.DriverMessages.decrement resources.DriverMessages.display resources.DriverMessages.increment resources.DriverMessages.on resources.DriverMessages.power resources.DriverMessages.recuperation /end REF_MEASUREMENT
/end GROUP
/end MODULE
/end PROJECT
